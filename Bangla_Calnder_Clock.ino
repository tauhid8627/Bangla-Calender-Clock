#include <LiquidCrystal.h>

#include <NTPClient.h>
#include <ESP8266WiFi.h>
#include <WiFiUdp.h>
#include <LedControl.h>
#include <Wire.h>
#include <SPI.h>  // not used here, but needed to prevent a RTClib compile error
#include "RTClib.h"

RTC_DS1307 RTC;


const char *ssid     = "Galaxy A52B523";
const char *password = "singaporebaby";

const long utcOffsetInSeconds = 6 * 3600;

byte devices = 8;
int DIN = 13; // D7
int CS =  12;  // D6
int CLK = 14;  // D5

LedControl lc = LedControl(DIN, CLK, CS, devices);


bool showDots;

byte znaky[150][8] = {
  { 0x00, 0x00, 0x00, 0x00, 0x00, 0x00, 0x00, 0x00 },   // U+0020 (space)
  { 0x18, 0x3C, 0x3C, 0x18, 0x18, 0x00, 0x18, 0x00 },   // U+0021 (!)
  { 0x36, 0x36, 0x00, 0x00, 0x00, 0x00, 0x00, 0x00 },   // U+0022 (")
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  {0x00, 0x7f, 0x10, 0x1e, 0x12, 0x12, 0x1e, 0x08},//r U+00A3

};


char daysOfTheWeek[7][12] = {"Sunday", "Monday", "Tuesday", "Wednesday", "Thursday", "Friday", "Saturday"};

// Define NTP Client to get time
WiFiUDP ntpUDP;
NTPClient timeClient(ntpUDP, "pool.ntp.org", utcOffsetInSeconds);
int wifi_ase = 0;
void setup() {
  Serial.begin(115200);
  //Wire.begin();
  WiFi.begin(ssid, password);

  byte l[8] = {0xC0, 0xC0, 0xC0, 0xC0, 0xC0, 0xC0, 0xFF, 0xFF}; // L
  byte I[8] = {0xFF, 0xFF, 0x18, 0x18, 0x18, 0x18, 0xFF, 0xFF}; // I
  byte f[8] = {0xff, 0xff, 0xc0, 0xfc, 0xfc, 0xc0, 0xc0, 0xc0}; // F
  byte h[8] = {0xC3, 0xC3, 0xC3, 0xFF, 0xFF, 0xC3, 0xC3, 0xC3}; // H
  byte t[8] = {0xFF, 0xFF, 0x18, 0x18, 0x18, 0x18, 0x18, 0x18}; // T
  byte c[8] = {0x3C, 0x66, 0x03, 0x03, 0x03, 0x66, 0x3C, 0x00}; //c

  byte w[8] = {0xc3, 0xc3, 0xc3, 0xdb, 0xdb, 0xff, 0xff, 0x00}; // w
  byte o[8] = {0x3C, 0x7E, 0xC3, 0xC3, 0xC3, 0xC3, 0x7E, 0x3C}; // O
  byte i[8] = {0x18, 0x18, 0x00, 0x18, 0x18, 0x18, 0x3c, 0x00}; // i
  byte s[8] = {0x7F, 0xFE, 0xC0, 0xFE, 0x7F, 0x03, 0x7F, 0xFE}; // S
  byte j[8] = {0xFF, 0xFF, 0xC0, 0xF8, 0xF8, 0xC0, 0xFF, 0xFF}; // E
  byte n[8] = {0x63, 0x63, 0x73, 0x7b, 0x6f, 0x67, 0x63, 0x63}; //N
  byte y[8] = {0x00, 0x41, 0x22, 0x14, 0x08, 0x08, 0x08, 0x08}; //y
  byte space[8] = {0x00, 0x00, 0x00, 0x00, 0x00, 0x00, 0x00, 0x00}; //space
  byte dot[8] = {0x00, 0x00, 0x00, 0x00, 0x00, 0x0C, 0x0C, 0x00};


  for (int i = 0; i < devices; i++)
  { lc.shutdown(i, false);      //The MAX72XX is in power-saving mode on startup
    lc.setIntensity(i, 0);     // Set the brightness to maximum value
    lc.clearDisplay(i);
  }

  delay (10000 );
  Serial.println("Wifi ki ache? ");
  Serial.println (WiFi.status() == WL_CONNECTED);
  if (WiFi.status() == WL_CONNECTED)
  {
    printByte(3, s);
    printByte(2, y);
    printByte(1, n);
    printByte(0, c);
    for (int k = 4; k < 8; k++) printByte(k, space);
    delay(5000);

    timeClient.begin();
    timeClient.update();
    Wire.begin(); // Start the I2C
    RTC.begin();  // Init RTC
    //Serial.println(timeClient);
    long actualTime = timeClient.getEpochTime();
    Serial.print("Internet Epoch Time: ");
    Serial.println(actualTime);
    RTC.adjust(DateTime(actualTime));
    wifi_ase = 1;
  }
  else
  {
    Wire.begin(); // Start the I2C
    printByte(3, space);
    printByte(2, n);
    printByte(1, o);
    printByte(0, space);

    printByte(7, w);
    printByte(6, i);
    printByte(5, f);
    printByte(4, i);
    delay(5000);

    //RTC.begin();
  }


  //timeClient.begin();
  int balsal = lc.getDeviceCount();
  Serial.println(balsal);




}



void loop() {

  Serial.print("Wifi ki ache? ");
  Serial.println (WiFi.status() == WL_CONNECTED);
  DateTime now = RTC.now();

  Serial.println(now.month());
  Serial.print(now.day(), DEC);
  Serial.print(' ');
  Serial.print(now.hour(), DEC);
  Serial.print(':');
  Serial.print(now.minute(), DEC);
  Serial.print(':');
  Serial.print(now.second(), DEC);
  Serial.println();

  int hourr   = now.hour();
  int minutee = now.minute();
  int dayOfWeekk = now.dayOfWeek();
  int currentYear = now.year();
  int currentMonth = now.month();
  int monthDay = now.day();

  String currentDate = String(currentYear) + "-" + String(currentMonth) + "-" + String(monthDay);
  Serial.print("Current date: ");
  Serial.println(currentDate);

  Serial.print(hourr);
  Serial.print(":");
  Serial.print(minutee);
  Serial.print(":");

  WriteTime(hourr, minutee);

  int koto_dibo = (hourr / 12);
  pm_na_am(koto_dibo);

  delay(2000);

  //show English date and year
  showDay(monthDay);
  showEngMonth(currentMonth);
  delay(4000);
  showYear(currentYear);
  delay(4000);



  int y = currentYear;
  int monthh = currentMonth;
  int dayOfMonth = monthDay;


  //Convert to bangla
  int yy = conv2bangla(int(dayOfMonth), int(monthh), y, 2);
  int m = conv2bangla(int(dayOfMonth), int(monthh), y, 1);
  //showMonth(m);
  int dayy = conv2bangla(int(dayOfMonth), int(monthh), y, 0);

  //show bangla date,month and year
  showDay(dayy);
  showMonth(m);
  delay(4000);
  showYear(yy);
  delay(4000);
  //if(dayOfWeek==0) dayOfWeek=6;
  //else if(dayOfWeek==1) dayOfWeek=7;

  showDayofWeek(dayOfWeekk);
  delay(2000);

  int arabic_day = gregorian_to_hijri(int(dayOfMonth), int(monthh), y, 0);
  int arabic_month = gregorian_to_hijri(int(dayOfMonth), int(monthh), y, 1);
  int arabic_year = gregorian_to_hijri(int(dayOfMonth), int(monthh), y, 2);

  Serial.println("Arabic Month");
  Serial.print(arabic_day);
  Serial.print("--");
  Serial.print(arabic_month);
  Serial.print("--");
  Serial.println(arabic_year);

  showDay(arabic_day);
  showArbiMonth(arabic_month);
  delay(4000);
  showYear(arabic_year);
  delay(4000);
}

void WriteTime(int hour, int minute) {
  //write time to matrix display

  //if (systemState == 0 || systemState
  //if (systemState == 0 || systemState == 2) {

  uint8_t hour12 = hour % 12 == 0 ? 12 : hour % 12;
  DrawSymbol(2, (hour12 % 10) + 16, 0);
  DrawSymbol(3, (hour12 / 10) + 16, 0);
  //}
  //year12 = year%100 == 0? 0 : year%100;
  //    DrawSymbol(7, (year12 % 10) + 16, 0);
  //    DrawSymbol(6, (year12 / 10) + 16, 0);
  //  }
  //
  //  if (systemState == 0 || systemState == 3) {
  //    DrawSymbol(4, (month % 10) + 16, 0);
  //    DrawSymbol(5, (month / 10) + 16, 0);
  //  }
  //
  //Serial.println("Ho magi");
  //Serial.println(hour);
  //Serial.println(month);

  //  if (systemState == 0 || systemState == 3) {
  DrawSymbol(0, (minute % 10) + 16, 1);
  DrawSymbol(1, (minute / 10) + 16, 1);
  // }

  //blinking dots on display
  //lc.setLed(2, 1, 7, showDots);  //addr, row, column
  //lc.setLed(2, 2, 7, showDots);
  //lc.setLed(2, 5, 7, showDots);
  lc.setLed(2, 6, 7, showDots);

  showDots = !showDots;
}

void DrawSymbol(byte adr, byte symbol, byte offset) {
  //draw symbol
  //offset move the symbol to right side

  for (int i = 0; i <= 7; i++) {
    byte dataRow = znaky[symbol][i];
    dataRow = ByteRevers(dataRow) >> offset;
    //Serial.println("there there");
    lc.setRow(adr, i, dataRow);
  }
}

byte ByteRevers(byte in) {
  //font turning
  byte out;
  out = 0;
  if (in & 0x01) out |= 0x80;
  if (in & 0x02) out |= 0x40;
  if (in & 0x04) out |= 0x20;
  if (in & 0x08) out |= 0x10;
  if (in & 0x10) out |= 0x08;
  if (in & 0x20) out |= 0x04;
  if (in & 0x40) out |= 0x02;
  if (in & 0x80) out |= 0x01;
  return (out);
}

void printByte(int j, byte character [])
{
  int i = 0;
  for (i = 0; i < 8; i++)
  {
    lc.setRow(j, i, character[i]);
  }
}
void showDayofWeek(int d) {
  //  DrawSymbol(7, 32-32, 0);  //space
  //  DrawSymbol(6, 32-32, 0);  //bri
  //  DrawSymbol(5, 32-32, 0);  //ho
  //  DrawSymbol(4,32-32, 0);   //space

  DrawSymbol(7, d * 2 + 72 - 32, 0); //bri
  DrawSymbol(6, d * 2 + 72 + 1 - 32,0); //ho
  DrawSymbol(5, 162 - 32, 0); //space
  DrawSymbol(4, 163 - 32, 0); //space
  //delay(2000);
}

void pm_na_am(int d) {
  if (d)
  { DrawSymbol(7, 128 - 32, 0); //op
    DrawSymbol(6, 134 - 32, 0); //po
    DrawSymbol(5, 135 - 32, 0); //ran
    DrawSymbol(4, 136 - 32, 0); //nho
  }

  else
  {
    DrawSymbol(7, 137 - 32, 0); //pur
    DrawSymbol(6, 138 - 32, 0); //ba
    DrawSymbol(5, 136 - 32, 0); //nho
    DrawSymbol(4, 32 - 32, 0); //space
  }
  //delay(2000);
}


void showYear(int y) {
  int charr = y % 10;
  y = y / 10;
  int tin = y % 10;
  y = y / 10;
  int dui = y % 10;
  y = y / 10;
  DrawSymbol(7, 16 + y, 0);
  DrawSymbol(6, 16 + dui, 0);
  DrawSymbol(5, 16 + tin, 0);
  DrawSymbol(4, 16 + charr, 0);
  //delay(2000);
}

void showMonth(int d) {

  d--;
  //DrawSymbol(7, 32-32, 0);  //space
  DrawSymbol(5, d * 2 + 86 - 32, 0); //bri
  DrawSymbol(4, d * 2 + 86 + 1 - 32, 0); //ho
  //DrawSymbol(4,32-32, 0);   //space
  //delay(2000);
}

void showEngMonth(int d) {

  d--;
  //DrawSymbol(7, 32-32, 0);  //space
  DrawSymbol(5, d * 2 + 110 - 32, 0); //bri
  DrawSymbol(4, d * 2 + 110 + 1 - 32, 0); //ho
  //DrawSymbol(4,32-32, 0);   //space
  //delay(2000);
}

void showArbiMonth(int d) {

  d--;
  //DrawSymbol(7, 32-32, 0);  //space
  DrawSymbol(5, d * 2 + 139 - 32, 0); //bri
  DrawSymbol(4, d * 2 + 139 + 1 - 32, 0); //ho
  //DrawSymbol(4,32-32, 0);   //space
  //delay(2000);
}


void showDay(int d) {
  //d--;
  DrawSymbol(7, (d / 10) + 48 - 32, 0); //space
  DrawSymbol(6, (d % 10) + 48 - 32, 0); //bri
  //DrawSymbol(5, d*2+86+1-32, 0);  //ho
  DrawSymbol(5, 32 - 32, 0);
  DrawSymbol(4, 32 - 32, 0); //space
  //delay(2000);
}




int conv2bangla(int date, int mash, int bochor, int konta)
{
  /*Serial.println("Function er shurute");
    Serial.println(date);
    Serial.println(mash);
    Serial.println(bochor);*/
  if (mash >= 4 && mash <= 12)
  {
    bochor = bochor - 593;
  }
  else
  {
    bochor = bochor - 1 - 593;
  }

  if (mash == 4)
  {

    if (bochor < 14)
    {
      mash = 12;
      //name="Chaitra";
      date = date + 14 + 3;
    }
    else if (date >= 14)
    {
      mash = 1;
      //name="Boishakh";
      date = date - 14 + 1;
    }

  }
  else if (mash == 5)
  {

    if (date < 15)
    {
      mash = 1;
      //name="Boishakh";
      date = date + 15 + 2;
    }
    else if (date >= 15)
    {
      mash = 2;
      //name="Joistha";
      date = date - 15 + 1;
    }

  }
  else if (mash == 6)
  {

    if (date < 15)
    {
      mash = 2;
      //name="Joistha";
      date = date + 15 + 2;
    }
    else if (date >= 15)
    {
      mash = 3;
      //name="Ashar";
      date = date - 15 + 1;
    }
  }
  else if (mash == 7)
  {

    if (date < 16)
    {
      mash = 3;
      //name="Ashar";
      date = date + 16;
    }
    else if (date >= 16)
    {
      mash = 4;
      //name="Srabon";
      date = date - 16 + 1;
    }
  }
  else if (mash == 8)
  {

    if (date < 16)
    {
      mash = 4;
      //name="Srabon";
      date = date + 16;
    }
    else if (date >= 16)
    {
      mash = 5;
      //name="Vadro";
      date = date - 16 + 1;
    }
  }
  else if (mash == 9)
  {

    if (date < 16)
    {
      mash = 5;
      //name="Vadro";
      date = date + 16;
    }
    else if (date >= 16)
    {
      mash = 6;
      //name="Ashwin";
      date = date - 16 + 1;
    }
  }
  else if (mash == 10)
  {

    if (date < 16)
    {
      mash = 6;
      //name="Aswin";
      date = date + 15;
    }
    else if (date >= 16)
    {
      mash = 7;
      //name="Kartik";
      date = date - 16 + 1;
    }
  }
  else if (mash == 11)
  {

    if (date < 15)
    {
      mash = 7;
      //name="Kartik";
      date = date + 15 + 1;
    }
    else if (date >= 15)
    {
      mash = 8;
      //name="Agrahoyon";
      date = date - 15 + 1;
    }

  }
  else if (mash == 12)
  {

    if (date < 15)
    {
      mash = 8;
      //name="Agrahoyon";
      date = date + 15 + 1;
    }
    else if (date >= 15)
    {
      mash = 9;
      //name="Poush";
      date = date - 15 + 1;
    }
  }
  else if (mash == 1)
  {

    if (date < 14)
    {
      mash = 9;
      //name="Poush";
      date = date + 14 + 3;
    }
    else if (date >= 14)
    {
      mash = 10;
      //name="Magh";
      date = date - 14 + 1;
    }

  }
  else if (mash == 2)
  {

    if (date < 13)
    {
      mash = 10;
      //name="Magh";
      date = date + 13 + 5;
    }
    else if (date >= 13)
    {
      mash = 11;
      //name="Falgun";
      date = date - 13 + 1;
    }
  }
  else if (mash == 3)
  {

    if (date < 15)
    {
      mash = 11;
      //name="Falgun";
      date = date + 15 + 2;
    }
    else if (date >= 15)
    {
      mash = 12;
      //name="Choitra";
      date = date - 15 + 1;
    }
  }
  /*Serial.println("Function er vitore");
    Serial.println(date);
    Serial.println(mash);
    Serial.println(bochor);*/
  if (!konta) return date;
  else if (konta == 1) return mash;
  else return bochor;
}


int gregorian_to_hijri(int g_y, int  g_m, int  g_d, int konta)
{
  int year, month, day;

  int zyr;
  int zd;
  int zm;
  int zy;

  float zjd;
  int zl;
  int zn;
  int zj;

  year = g_y;
  month = g_m;
  day = g_d;


  zyr = year;
  zd = day;
  zm = month;
  zy = zyr;

  if ((zy > 1582) || ((zy == 1582) && (zm > 10)) || ((zy == 1582) && (zm == 10) && (zd > 14)))
  {
    zjd = ((1461 * (zy + 4800 + ((zm - 14) / 12))) / 4)
          + ((367 * (zm - 2 - 12 * (((zm - 14) / 12)))) / 12)
          - ((3 * (((zy + 4900 + ((zm - 14) / 12)) / 100))) / 4) + zd - 32075;
  }
  else
  {
    zjd = 367 * zy - ((7 * (zy + 5001 + ((zm - 9) / 7))) / 4)
          + ((275 * zm) / 9) + zd + 1729777;
  }

  zl = zjd - 1948440 + 10632;
  zn = ((zl - 1) / 10631);
  zl = zl - 10631 * zn + 354;
  zj = (((10985 - zl) / 5316)) * ((int)((50 * zl) / 17719))
       + ((zl / 5670)) * ((int)((43 * zl) / 15238));

  zl = zl - (((30 - zj) / 15)) * (((17719 * zj) / 50))
       - ((zj / 16)) * (((15238 * zj) / 43)) + 29;

  zm = ((24 * zl) / 709);
  zd = zl - ((709 * zm) / 24);
  zy = 30 * zn + zj - 30;

  int h_y = zy;
  int h_m = zm;
  int h_d = zd;

  if (!konta) return h_d;
  else if (konta == 1) return h_m;
  else return h_y;
}
